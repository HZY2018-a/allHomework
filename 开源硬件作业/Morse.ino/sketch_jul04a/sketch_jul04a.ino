//将字母用莫尔斯码表示,'.'为点，'_'为划
char Morse[][4]=
{{'.','_','*','*'},//A
 {'_','.','.','.'},//B
 {'_','.','_','.'},//C
 {'_','.','.','*'},//D
 {'.','*','*','*'},//E
 {'.','.','_','.'},//F
 {'_','_','.','*'},//G
 {'.','.','.','.'},//H
 {'.','.','*','*'},//I
 {'.','_','_','_'},//J
 {'_','.','_','*'},//K
 {'.','_','.','.'},//L
 {'_','_','*','*'},//M
 {'_','.','*','*'},//N
 {'_','_','_','*'},//O
 {'.','_','_','.'},//P
 {'_','_','.','_'},//Q
 {'.','_','.','*'},//R
 {'.','.','.','*'},//S
 {'_','*','*','*'},//T
 {'.','.','_','*'},//U
 {'.','.','.','_'},//V
 {'.','_','_','*'},//W
 {'_','.','.','_'},//X
 {'_','.','_','_'},//Y
 {'_','_','.','.'}//Z
};



void setup()
{
  Serial.begin(9600);//通信波特率
 
} 

void loop() 
{
  String str = "";//转义字符
  String morse = "";//转义后字符
  int i,t;
  int temp = 0 , n = 0;//n为转入字符个数
  while(Serial.available()>0)
  {
      temp = 1;
      str += char(Serial.read());//将转入数据存储在字符中
      delay(2);
      n++;
  }
  //进行摩尔斯码的转换
  if (temp)
  {
    for (i = 0;i < n;i++)
    {   for(t = 0;t < 4;t++)
        {
           if(str[i] >= 97 && str[i] <= 122)//大小写转换
               morse += char(Morse[int(str[i]-97)][t]);
    }
    morse += ' ';
  }
  Serial.print(morse);
 }
 delay(2);
}
